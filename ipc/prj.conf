## CMakeLists.txt
```
# SPDX-License-Identifier: Apache-2.0

cmake_minimum_required(VERSION 3.28.0)

set(BOARD_DIRECTORIES ${CMAKE_CURRENT_LIST_DIR}/../../zephyr_board/stm32_h743xih6_custom)

find_package(Zephyr REQUIRED HINTS $ENV{ZEPHYR_BASE})
project(bootloader)

target_sources(app PRIVATE 
    src/main.c
    src/app_shell.c
    api/api_i2c.c
    api/api_uart.c
    api/api_ymodem.c
    api/api_sd.c
)

target_include_directories(app PRIVATE
    ${CMAKE_CURRENT_SOURCE_DIR}/api
    ${CMAKE_CURRENT_SOURCE_DIR}/src
)
```

## prj.conf
```kconfig
# nothing here
CONFIG_KERNEL_BIN_NAME="ipc"
CONFIG_NO_OPTIMIZATIONS=y
CONFIG_DEBUG=y
CONFIG_USE_DT_CODE_PARTITION=y

#off banner massage
CONFIG_BOOT_BANNER=n

CONFIG_USE_DT_CODE_PARTITION=y
CONFIG_REBOOT=y
CONFIG_RTC=y
CONFIG_CONSOLE=y
CONFIG_UART_CONSOLE=y
CONFIG_SHELL_BACKEND_SERIAL=y
CONFIG_SHELL=y
CONFIG_DCACHE=n
CONFIG_DATE_SHELL=n

#uart 설정
CONFIG_UART_ASYNC_API=y
CONFIG_UART_INTERRUPT_DRIVEN=y

#i2c 설정
CONFIG_I2C=y

#mem 설정
CONFIG_MEMC=y

#스택 크기 설정
CONFIG_MAIN_STACK_SIZE=16384
CONFIG_SHELL_STACK_SIZE=16384

#sdmmc 설정
CONFIG_SDMMC_STACK=y
CONFIG_DISK_ACCESS=y
CONFIG_FAT_FILESYSTEM_ELM=y
CONFIG_FS_FATFS_EXFAT=y
CONFIG_FILE_SYSTEM=y
CONFIG_FILE_SYSTEM_SHELL=y
#sdmmc_ker_clk클럭을 48Mhz로 고정하는 설정
CONFIG_SDMMC_STM32_CLOCK_CHECK=n
```

## src/main.c
```c
#include <zephyr/kernel.h>
#include <stdio.h>
#include <stdint.h>
#include "main.h"
#include <errno.h>
#include "api_sd.h"


int main(void)
{
    int ret = 0;

    sd1_mount();
    sd_get_cid(CONFIG_SDMMC1_DEVICE_NAME);

    return ret;
}
```
